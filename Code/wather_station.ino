#include <Wire.h>
#include <SPI.h>
#include <Adafruit_BMP280.h>
#include <DS3231.h>
#include <DHT.h>

#include <Adafruit_GFX.h>
#include <Adafruit_SSD1306.h>
#include <Fonts/FreeSans9pt7b.h>
#include <Fonts/FreeMonoBoldOblique12pt7b.h>
//#include <Fonts/FreeMonoBoldOblique9pt7b.h>

#define SCREEN_WIDTH 128
#define SCREEN_HEIGHT 64
#define OLED_RESET     4
Adafruit_SSD1306 display(SCREEN_WIDTH, SCREEN_HEIGHT, &Wire, OLED_RESET);

#define BMP_SCK  (13)
#define BMP_MISO (12)
#define BMP_MOSI (11)
#define BMP_CS   (10)

DS3231 clock;
bool century = false;
bool h12Flag;
bool pmFlag;

Adafruit_BMP280 bmp(BMP_CS, BMP_MOSI, BMP_MISO,  BMP_SCK);

#define DHTPIN  2
#define DHTTYPE DHT11
DHT dht(DHTPIN, DHTTYPE);



const unsigned char PROGMEM frame0 [] = {0x00, 0x00, 0x00, 0x00, 0x00, 0x00, 0x00, 0x00, 0x00, 0x00, 0x00, 0x01, 0xFF,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 0x00, 0x00};
const unsigned char PROGMEM frame1 [] = {0x00, 0x00, 0x00, 0x00, 0x00, 0x00, 0x00, 0x18, 0x00, 0x00, 0x00, 0x00, 0x7E,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 0x00, 0x00};
const unsigned char PROGMEM frame2 [] = {0xFF, 0xFF, 0xFF, 0xFF, 0xFF, 0xFF, 0xFF, 0xFF, 0xFF, 0xFF, 0xFF, 0xFF, 0xFF,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 0xFF, 0x80};



void setup() {
  Serial.begin(57600);
  if (!display.begin(SSD1306_SWITCHCAPVCC, 0x3C)) {
    Serial.println(F("SSD1306 failed"));
  }
  Wire.begin();
  dht.begin();
  if (!bmp.begin()) {
    Serial.println(F("Problem.bmp"));
    while (1) delay(10);
  }
  display.clearDisplay();
  display.setTextColor(WHITE);
  display.setTextSize(1);
  display.setCursor(0, 9);
  display.setFont(&FreeSans9pt7b);
  display.println("**** LOCAL ****");
  display.setCursor(0, 38);
  display.setFont(&FreeMonoBoldOblique12pt7b);
  display.println("wather");
  display.setCursor(27, 58);
  display.println("Station");
  display.display();
  delay(2000);


  bmp.setSampling(Adafruit_BMP280::MODE_NORMAL,     /* Operating Mode. */
                  Adafruit_BMP280::SAMPLING_X2,     /* Temp. oversampling */
                  Adafruit_BMP280::SAMPLING_X16,    /* Pressure oversampling */
                  Adafruit_BMP280::FILTER_X16,      /* Filtering. */
                  Adafruit_BMP280::STANDBY_MS_500); /* Standby time. */

}


void loop() {

  //Time
  display.clearDisplay();
  display.setTextColor(WHITE);
  display.setTextSize(1);
  display.setCursor(13, 15);
  display.setFont(&FreeMonoBoldOblique12pt7b);
  display.print(clock.getHour(h12Flag, pmFlag));
  display.setCursor(38, 15);
  display.println(":");
  display.setCursor(50, 15);
  display.println(clock.getMinute());
  display.setCursor(70, 15);
  if (pmFlag) {
    display.println(" PM");
  } else {
    display.println(" AM ");
  }
  display.setFont(&FreeSans9pt7b);

  display.setCursor(20, 60);
  display.println(clock.getDate());
  display.setCursor(40, 60);
  display.println("/");
  display.setCursor(46, 60);
  display.println(clock.getMonth(century));
  display.setCursor(65, 60);
  display.println("/");
  display.setCursor(70, 60);
  display.println("20");
  display.setCursor(90, 60);
  display.println(clock.getYear());
  display.setCursor(30, 30);
  display.setFont(&FreeSans9pt7b);
  switch (clock.getDoW()) {
    case 1:
      display.println("Saturday");
      break;
    case 2:
      display.println("Sunday");
      break;
    case 3:
      display.println("Monday");
      break;
    case 4:
      display.println("Tuesday");
      break;
    case 5:
      display.println("Wednesday");
      break;
    case 6:
      display.println("Thursday");
      break;
    case 7:
      display.println("Friday");
      break;
  }


  display.display();
  delay(5000);
  //P
  display.clearDisplay();
  display.drawBitmap(0, 0, frame0, 40, 40, 1);
  display.setFont(&FreeSans9pt7b);
  display.setCursor(41, 28);
  display.println(bmp.readPressure() / 100);
  display.setCursor(110, 28);
  display.setFont();
  display.println("hPa");
  display.setCursor(0, 55);
  display.setFont(&FreeSans9pt7b);
  display.println("Altitude:");
  display.setCursor(65, 62);
  display.println(bmp.readAltitude(1005.47));
  display.setCursor(113, 62);
  display.println("m");
  display.display();
  delay(5000);
  //T&RH
  display.clearDisplay();
  display.setFont(&FreeMonoBoldOblique12pt7b);
  display.drawBitmap(0, 5, frame1, 40, 51, 1);
  display.setCursor(35, 30);
  display.print(bmp.readTemperature());
  display.setFont(&FreeSans9pt7b);
  display.setCursor(102, 28);
  display.println(" *");
  display.setCursor(110, 31);
  display.println(" C");
  display.setFont();
  display.setCursor(66, 45);
  display.println("RH :");
  byte RH = dht.readHumidity();
  display.setCursor(95, 45);
  display.println(RH);
  display.setCursor(110, 45);
  display.println("%");
  display.drawBitmap(0, 56, frame2, 135, 15, 1);
  display.display();
  delay(5000);
  //UV
  display.clearDisplay();
  float sensorValue = analogRead(A0);
  float sensorVoltage = sensorValue / 1024 * 5.0;
  int UV_index = sensorVoltage / 0.1;
  display.setFont(&FreeSans9pt7b);
  display.setCursor(0, 15);
  display.print("    UV INDEX  ");
  display.setCursor(58, 45);
  display.println(UV_index);
  display.display();
  delay(5000);
}
